/*
 * 百分百命中 / LD14 独立测试桥 V0.1
 * 功能：LD14 UART2 -> ESP32 -> USB串口 + WiFi UDP
 * 不接入M100运动控制，不产生任何运动命令。
 *
 * 接线（经典 ESP32 Dev Module）：
 * LD14 Tx  -> ESP32 GPIO16 (RX2)
 * LD14 GND -> ESP32 GND
 * LD14 P5V -> 独立稳定5V（不要接ESP32 3V3）
 * LD14 PWM -> GND或悬空，使用内部6Hz控速
 * 所有电源必须共地。
 */
#include <WiFi.h>
#include <WiFiUdp.h>

// ========== 用户配置 ==========
const char* WIFI_SSID = "YOUR_WIFI_NAME_HERE";
const char* WIFI_PASS = "YOUR_WIFI_PASSWORD_HERE";
#define ENABLE_WIFI 1
#define ENABLE_USB_FORWARD 1
#define ENABLE_UDP_FORWARD 1

// ========== LD14 UART ==========
HardwareSerial LidarSerial(2);
const int LD14_RX_PIN = 16;
const int LD14_TX_PIN = 17; // 不连接LD14，仅用于完成UART2映射
const uint32_t LD14_BAUD = 115200;
const size_t LD14_FRAME_LEN = 47;
uint8_t frame[LD14_FRAME_LEN];
size_t framePos = 0;

// ========== PC链路 ==========
const uint32_t USB_BAUD = 921600;
const uint16_t UDP_CMD_PORT = 4210;
const uint16_t UDP_DATA_PORT = 4211;
WiFiUDP udp;
IPAddress pcIP;
bool hasPC = false;
uint32_t goodFrames = 0, badFrames = 0, droppedPackets = 0;

static const uint8_t CRC_TABLE[256] = {0x00, 0x4D, 0x9A, 0xD7, 0x79, 0x34, 0xE3, 0xAE, 0xF2, 0xBF, 0x68, 0x25, 0x8B,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 0xE5, 0xA8};

uint8_t calCRC8(const uint8_t* p, size_t len) {
  uint8_t crc = 0;
  for (size_t i = 0; i < len; ++i) crc = CRC_TABLE[(crc ^ p[i]) & 0xFF];
  return crc;
}

void forwardFrame(const uint8_t* p) {
#if ENABLE_USB_FORWARD
  Serial.write(p, LD14_FRAME_LEN); // PC端直接按0x54 0x2C同步
#endif
#if ENABLE_WIFI && ENABLE_UDP_FORWARD
  if (hasPC && WiFi.status() == WL_CONNECTED) {
    if (udp.beginPacket(pcIP, UDP_DATA_PORT)) {
      udp.write(p, LD14_FRAME_LEN);
      if (!udp.endPacket()) droppedPackets++;
    } else droppedPackets++;
  }
#endif
}

void feedLidarByte(uint8_t b) {
  if (framePos == 0) {
    if (b == 0x54) frame[framePos++] = b;
    return;
  }
  if (framePos == 1) {
    if (b == 0x2C) frame[framePos++] = b;
    else { framePos = 0; if (b == 0x54) frame[framePos++] = b; }
    return;
  }
  frame[framePos++] = b;
  if (framePos == LD14_FRAME_LEN) {
    if (calCRC8(frame, LD14_FRAME_LEN - 1) == frame[LD14_FRAME_LEN - 1]) {
      goodFrames++;
      forwardFrame(frame);
    } else badFrames++;
    framePos = 0;
  }
}

void handleUdpCommand() {
#if ENABLE_WIFI
  int n = udp.parsePacket();
  if (n <= 0) return;
  char cmd[32] = {0};
  int got = udp.read((uint8_t*)cmd, sizeof(cmd) - 1);
  if (got <= 0) return;
  pcIP = udp.remoteIP();
  hasPC = true;
  if (strncmp(cmd, "HELLO", 5) == 0) {
    char msg[96];
    snprintf(msg, sizeof(msg), "LD14ESP,ip=%s,good=%lu,bad=%lu",
             WiFi.localIP().toString().c_str(),
             (unsigned long)goodFrames, (unsigned long)badFrames);
    udp.beginPacket(pcIP, UDP_DATA_PORT);
    udp.write((const uint8_t*)msg, strlen(msg));
    udp.endPacket();
  }
#endif
}

void setup() {
  Serial.begin(USB_BAUD);
  LidarSerial.setRxBufferSize(4096);
  LidarSerial.begin(LD14_BAUD, SERIAL_8N1, LD14_RX_PIN, LD14_TX_PIN);
#if ENABLE_WIFI
  WiFi.mode(WIFI_STA);
  WiFi.setSleep(false);
  WiFi.begin(WIFI_SSID, WIFI_PASS);
  uint32_t t0 = millis();
  while (WiFi.status() != WL_CONNECTED && millis() - t0 < 15000) delay(100);
  if (WiFi.status() == WL_CONNECTED) udp.begin(UDP_CMD_PORT);
#endif
}

void loop() {
  while (LidarSerial.available() > 0) feedLidarByte((uint8_t)LidarSerial.read());
  handleUdpCommand();
}
